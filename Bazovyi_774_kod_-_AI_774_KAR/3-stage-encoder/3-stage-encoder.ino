#include <Servo.h>

Servo motor;                 
Servo myservo;

// Значения углов для севропривода
const int CENTER = 90;  // Центральное положение колёс
const int MIN_ANGLE = 55;  // Минимально допустимое, определяется экспериментально
const int MAX_ANGLE = 125;  // Максимально допустимое, опеределяется экспериментально

volatile unsigned long Dist=0;  // Число срабатываний энкодера, которое необходимо проехать
// volatile - сообщает компилятору, что переменную не нужно доступ к ней
// Так объявляют переменные, которые изменяются внутри обработчика прерываний

// Обработчик прерывания
void EventEncoderPulse(){  // Срабатывает при появлении импульса от энкодера
  if (Dist > 0){ 
    Dist--;        // Обратный отсчёт срабатываний, которые необходимо проехать
  }
}

void setup() 
{
  Serial.begin(115200); // Открываем последовательный порт для общения на скорости 115200 бод
  pinMode(13, OUTPUT); // Вывод с подключённым светодиодом переводим в режим ВЫХОД
  myservo.attach(8);
  myservo.write(CENTER);
  motor.attach(7);
  motor.writeMicroseconds(1500);

  // Назначаем обработчик для внешнего прерывания на цифровом пине 2
  // Обраотчик прерывания выполняется при  понижении уровня напряжения
  attachInterrupt(digitalPinToInterrupt(2), EventEncoderPulse, FALLING); 
  
  delay(1500);
}

// Сообщения длиннее 32 символов не предусмотрены нашим протоколом общения с одноплатным компьютером
const uint8_t CMD_BUF_SIZE = 32+1;  // Размер буфера для приёма собщений, ещё один символ для "\0"
// В C/C++ строки, представленные как массив байт заканчиваются '\0'
// Например, char s[] = "Hi"; // в памяти: 'H','i','\0'.

char rxBuffer[CMD_BUF_SIZE];  // Массив символов, буфер для хранения текста принимаемого сообщения
uint8_t cmdIdx = 0;  // Индекс символа в буфере, который необходимо записать следующим
bool start_msg_flag = false;  // Равен true если мы ранее нашли начало сообщения
// Флаг показывает, что нужно добавлять символы к тексту сообщения

// Приём сообщения побайтно; возвращает true, когда получена полная строка
bool receiveMessage() {
  char c;
  
  while (Serial.available()) {  // Пока есть байты, доступные для чтения ...
    c = Serial.read();  // Читаем байт - один символ

    if (c == '*') {  // Если нашли начало сообщения, то ...
      cmdIdx = 0;    // Готовимся записать первый символ
      start_msg_flag = true;  // Выставляем флаг начала сообщения
      continue;
    }

    // только в случае, когда мы уже нашли начало сообщения,
    // мы записываем символы в буфер
    if (start_msg_flag) {
      if (cmdIdx < CMD_BUF_SIZE-1) {// В буфере есть место для записи текущего символа есть
        
        if (c == '|') {  // Если мы прочитали символ '|', значит сообщение закончилось
          rxBuffer[cmdIdx] = '\0';  // добавляем окончание строки
          start_msg_flag = false;
          return true;  // Завершаем функцию, возвращаем true, сообщение целиком записано в rxBuffer
        } else {
          rxBuffer[cmdIdx] = c;  // записываем символ в буфер
          cmdIdx++;
        }
      } else { // Места в буфере для текущего символа нет
        // Сообщение слишком длинное и не соответствует формату протокола
        start_msg_flag = false;  // Опять ищем символ начала строки
        cmdIdx = 0;  // Запись следующего сообщения начнётся с начала буфера
      }          
    }
  }
  // Если цикл завершился, значит нет данных для чтения, завершаем функцию
  return false;  // Возвращаем false, в rxBuffer ещё нет целого сообщения, готового для обработки
  // мы продолжим запись сообщения в буфер, при следующем вызове receiveMessage
}

bool DistModeStatus = false; // Показывает нужнужно отсчитывать пройденную дистанцию или нет
int Speed = 1500;  // Скорость, с которой необходимо двигаться
int Angle = 90;  // Угол поворота сервопривода, который необходимо удерживать

// Анализ содержания сообщения и выполнение соответствующих действий
bool parseMessage() {
  // Команда STOP имеет только текстовое поле, её легко отличить от остальных команд
  if (strncmp(rxBuffer, "STOP", 4) == 0) { //сравнивает 4 байта буфера и "STOP"
    motor.writeMicroseconds(1500);  
    Speed = 1500;
    Serial.print("*OK_STOP|"); // отправляем ответ
    return true; // команда распознана, завершаем функцию
  }
  
  if (strncmp(rxBuffer, "GET_DIST", 8) == 0) {
    Serial.print("*STAT_DIST:"); // отправляем начало ответа
    Serial.print(Dist);  // отправляем число, оно автоматически переведётся в текстовое представление
    Serial.print("|");  // добавляем символ конца сообщения
    return true; // команда распознана, завершаем функцию  
  }

  //Проверяем совпадение первой части сообщения
  if (strncmp(rxBuffer, "SET_DIST:", 9) == 0) {
    // Читаем числов в десятичной системе, начиная с (9+1) десятого символа строки rxBuffer до '\0'
    long value_dist = strtol(rxBuffer + 9, nullptr, 10);  // Запоминаем дистанцию, которую нужно проехать
    if (value_dist <= 0) {  // Отрицательные и нулевые числа воспринимаем как команду прекратить отсчёт дистанции
      Dist = 0;                          // Обнуляем значение
      DistModeStatus = false;            // Отключаем обратный отсчёт дистанции
    } else {
      Dist = (unsigned long)value_dist;
      DistModeStatus = true;             // Начинаем обратный отсчёт дистанции
    }

    Serial.print("*OK_DIST:"); // Отправляем начало ответа
    Serial.print(Dist);  // Отправляем число
    Serial.print("|");  // Добавляем символ конца сообщения
    return true; // Команда распознана, завершаем функцию  
  }

  // Проверяем совпадение первой части сообщения
  if (strncmp(rxBuffer, "SET_SPEED:", 10) == 0) {
    // Читаем числов в десятичной системе, начиная с (10+1) символа строки rxBuffer до '\0'
    Speed = strtol(rxBuffer + 10, nullptr, 10);  // Запоминаем дистанцию, которую нужно проехать
    // ОГРАНИЧЕНИЯ ПО СКОРОСТИ!
    if (Speed < 600) {Speed = 600;}
    if (Speed > 2400) {Speed = 2400;}
    motor.writeMicroseconds(Speed);
    return true; // Команда распознана, завершаем функцию  
  }

  // Проверяем совпадение первой части сообщения
  if (strncmp(rxBuffer, "SET_ANGLE:", 10) == 0) {
    Angle = strtol(rxBuffer + 10, nullptr, 10);  // Запоминаем дистанцию, которую нужно проехать
    // ОГРАНИЧЕНИЯ ПО УГЛАМ!
    if (Angle < MIN_ANGLE) {Angle = MIN_ANGLE;}
    if (Angle > MAX_ANGLE) {Angle = MAX_ANGLE;}
    myservo.write(Angle);
    return true; // Команда распознана, завершаем функцию  
  }

  // Проверяем совпадение первой части сообщения
  if (strncmp(rxBuffer, "SET_LED:", 8) == 0) {
    int value = strtol(rxBuffer + 8, nullptr, 10);  // Получаем число из сообщения
    if (value >= 1) {digitalWrite(13, HIGH);}  // Включаем светодиод
    if (value <= 0) {digitalWrite(13, LOW);}  // Выключаем светодиод
    return true; // Команда распознана, завершаем функцию  
  }

  return false;  // Мы не смогли интерпретировать команду в сообщении
}


void loop() {
  // Цикл обработки сообщений работает пока в буфере остаются не прочитанные целые сообщения
  // Как только целые сообщения закончились - цикл завершается
  while (receiveMessage()) {       // Получаем сообщение целиком без '*' и '|' в rxBuffer
    parseMessage();                // Парсим и выполняем команду
  }

  // Проверяем, что обратный отсчёт дошёл до нуля, а не принудительно завершён пользователем
 if (DistModeStatus == true and Dist == 0) { 
    DistModeStatus = false;  // Отключаем обратный отсчёт
    motor.writeMicroseconds(1500);  // Останавливаем двигатель
    Speed = 1500;   // Сохраняем значение скорости
  }

  // Остальная логика устройства...
  // Например, получение данных от дальномеров и остановка в случае обнаружения препятствий

  delay(1); // Пауза, между попытками получения сообщения
  // Около 1000 раз в секунду более чем достаточно для нашей задачи
  // Паузу можно убрать, реализация остальной логики устройства будет играть роль паузы.
}
